/dts-v1/;
/plugin/;

/ {
    compatible = "brcm,bcm2711", "brcm,bcm2835"; 

    fragment@0 {
        target = <&i2c1>;  // i2c-1 on pi
        __overlay__ {
            #address-cells = <1>;
            #size-cells = <0>;

            mcp9808_personal@18 {
                compatible = "asolonari,mcp9808-personal";
                reg = <0x18>;
                status = "okay";
            };
        };
    };
};
